// SPDX-License-Identifier: GPL-2.0-or-later
/dts-v1/;
/plugin/;

/*
 * Test-only overlay for the built-in BCM2835 AUX SPI1 driver.  The board DTB
 * keeps SPI1 disabled by default, as production Pi 4-family DTBs do.
 *
 * The child is bound to spidev rather than to a SPI-NOR driver on purpose.
 * The AUX controller's native chip select is deasserted after every
 * spi_transfer, so a SPI-NOR command-then-data message cannot hold it; the
 * driver itself documents that and asks for cs-gpios instead.  A single
 * full-duplex spidev transfer is the exchange this controller can complete,
 * and it is the one the model implements.
 */
/ {
    fragment@0 {
        target = <&spi1>;

        __overlay__ {
            status = "okay";
            #address-cells = <1>;
            #size-cells = <0>;

            spidev@0 {
                compatible = "rohm,dh2228fv";
                reg = <0>;
                spi-max-frequency = <1000000>;
            };
        };
    };
};
